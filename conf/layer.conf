## conf/layer.conf
```bitbake
# We have a conf and classes directory, add to BBPATH
BBPATH .= ":${LAYERDIR}"

# We have recipes-* directories, add to BBFILES
BBFILES += "${LAYERDIR}/recipes-*/*/*.bb \
            ${LAYERDIR}/recipes-*/*/*.bbappend"

BBFILE_COLLECTIONS += "meta-strat"
BBFILE_PATTERN_meta-strat = "^${LAYERDIR}/"
BBFILE_PRIORITY_meta-strat = "6"

LAYERDEPENDS_meta-strat = "core"
LAYERDEPENDS_meta-strat += "openembedded-layer"

LAYERSERIES_COMPAT_meta-strat = "gatesgarth dunfell zeus"

BBFILES_DYNAMIC += " \
  qt5-layer:${LAYERDIR}/dynamic-layers/qt5-layer/*/*/*.bb \
  qt5-layer:${LAYERDIR}/dynamic-layers/qt5-layer/*/*/*.bbappend \
  meta-qt5-extra:${LAYERDIR}/dynamic-layers/qt5-extra-layer/*/*/*.bb \
  meta-qt5-extra:${LAYERDIR}/dynamic-layers/qt5-extra-layer/*/*/*.bbappend \
"
```
